## layers/meta-webdomu/conf/layer.conf
```bitbake
BBPATH .= ":${LAYERDIR}"
BBFILES += "${LAYERDIR}/recipes-*/*/*.bb \
            ${LAYERDIR}/recipes-*/*/*.bbappend"

BBFILE_COLLECTIONS += "meta-webdomu"
BBFILE_PATTERN_meta-webdomu = "^${LAYERDIR}/"
BBFILE_PRIORITY_meta-webdomu = "6"
LAYERDEPENDS_meta-webdomu = "core"
LAYERSERIES_COMPAT_meta-webdomu = "scarthgap"
```
